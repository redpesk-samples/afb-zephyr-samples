## CMakeLists.txt
```
#
#
# SPDX-License-Identifier: Apache-2.0

cmake_minimum_required(VERSION 3.20.0)

# basic detection of afb-zephyr
if("" STREQUAL "$ENV{AFB_ZEPHYR_DIR}")
   set(ENV{AFB_ZEPHYR_DIR} "$ENV{HOME}/zephyrproject/afb-zephyr")
endif()
list(APPEND EXTRA_ZEPHYR_MODULES "$ENV{AFB_ZEPHYR_DIR}")

# finding Zephyr
find_package(Zephyr REQUIRED HINTS $ENV{ZEPHYR_BASE})

# set project
project(afb-local)
target_sources(app PRIVATE src/main.c)
```

## prj.conf
```kconfig
CONFIG_AFB_ZEPHYR=y
CONFIG_BOOT_BANNER=n

#CONFIG_SERIAL=y
#CONFIG_CONSOLE=y
#CONFIG_UART_CONSOLE=y
```

## src/main.c
```c
/*
 * Copyright (c) 2015-2025 IoT.bzh Company
 *
 * SPDX-License-Identifier: Apache-2.0
 */

#include <stdio.h>
#include <zephyr/kernel.h>

#include <zafb-helpers.h>

#include <sys/rp-verbose.h>
#include <afb-v4.h>

static void hello_verb_cb(afb_req_t req, unsigned nparams, afb_data_t const *params);
static int tuto_mainctl(afb_api_t api, afb_ctlid_t ctlid, afb_ctlarg_t ctlarg, void *userdata);

static const afb_verb_t tuto_desc_verbs[] = {
	{ .verb="hello", .callback=hello_verb_cb },
	{ .verb=NULL }
};

static const afb_binding_t tuto0_desc_api = {
	.api = "tuto0",
	.mainctl = tuto_mainctl,
	.verbs = tuto_desc_verbs
};

static const afb_binding_t tuto1_desc_api = {
	.api = "tuto1",
	.mainctl = tuto_mainctl,
	.verbs = tuto_desc_verbs
};

static afb_api_t tuto0, tuto1;

/* API TUTO SECTION - START */
/* hello verb callback */
static void hello_verb_cb(afb_req_t req, unsigned nparams, afb_data_t const *params)
{
	int retcod;
	const char *who = "World"; /* default value */
	char hello[100];
	afb_data_t reply, name;

	/* some output for tracking the process */
	AFB_REQ_DEBUG(req, "Hi debugger!");

	/* extract the name of the caller */
	retcod = afb_req_param_convert(req, 0, AFB_PREDEFINED_TYPE_STRINGZ, &name);
	who = retcod == 0 ? afb_data_ro_pointer(name) : "World" /* default value */;
	AFB_REQ_NOTICE(req, "Hi observer! I'm %s and I received hello from %s", afb_req_get_called_api(req), who);

	/* create the reply string */
	retcod = snprintf(hello, sizeof hello, "Hello %s!", who);
	if (retcod >= (int)sizeof hello) {
		AFB_REQ_WARNING(req, "name too long, truncated!");
		retcod = (int)sizeof hello - 1;
		hello[retcod] = 0;
	}

	/* make the reply string */
	afb_create_data_copy(&reply, AFB_PREDEFINED_TYPE_STRINGZ, hello, (size_t)(retcod + 1 /*with last zero*/));
	afb_req_reply(req, 0, 1, &reply);
}

static int tuto_mainctl(afb_api_t api, afb_ctlid_t ctlid, afb_ctlarg_t ctlarg, void *userdata)
{
	switch (ctlid) {
	case afb_ctlid_Pre_Init:
		AFB_API_NOTICE(api, "hello binding comes to live with uid %s", ctlarg->pre_init.uid);
		break;

	case afb_ctlid_Init:
		AFB_API_NOTICE(api, "hello binding starting");
		break;

	default:
		break;
	}
	return 0;
}

static void onrep(
	void *closure,
	int status,
	unsigned nreplies,
	afb_data_t const replies[],
	afb_api_t api
) {
	int rc;
	unsigned idx;
	afb_data_t str;

	AFB_API_NOTICE(api, "reply received");

	if (AFB_IS_ERRNO(status))
		AFB_API_NOTICE(api, "got error %d", status);

	for (idx = 0 ; idx < nreplies ; idx++) {
		rc = afb_data_convert(replies[idx], AFB_PREDEFINED_TYPE_STRINGZ, &str);
		if (rc >= 0) {
			AFB_API_NOTICE(api, "got data %u as string %s", idx, (const char *)afb_data_ro_pointer(str));
			afb_data_unref(str);
		}
		else
			AFB_API_NOTICE(api, "got data %u of type %s", idx, afb_type_name(afb_data_type(str)));
	}

	AFB_API_NOTICE(api, "leaving");
}

void start(int signum, void* arg)
{
	RP_INFO("Adding APIs ...");
	zafb_binding_add(&tuto0, &tuto0_desc_api);
	zafb_binding_add(&tuto1, &tuto1_desc_api);

	RP_INFO("Starting APIs ...");
	zafb_start();

	afb_data_t reply;

	RP_INFO("API tuto0 call API tuto1 hello verb with arg \"zephyr\"");
	afb_create_data_raw(&reply, AFB_PREDEFINED_TYPE_STRINGZ, "zephyr", 7, NULL, NULL);
	afb_api_call(tuto0, "tuto1", "hello", 1, &reply, onrep, NULL);

	k_sleep(K_MSEC(1000));

	RP_INFO("API tuto1 call API tuto0 hello verb with arg \"zephyr\"");
	afb_create_data_raw(&reply, AFB_PREDEFINED_TYPE_STRINGZ, "zephyr", 7, NULL, NULL);
	afb_api_call(tuto1, "tuto0", "hello", 1, &reply, onrep, NULL);
}

static void run_afb()
{
	rp_set_logmask(rp_Log_Mask_Debug);
	afb_ev_mgr_init();
	afb_sched_start(1, 1, 30, start, NULL);
}

int main(void)
{
	run_afb();
	return 0;
}
```

## src/zafb-helpers.c
```c
/*
 * Copyright (c) 2015-2025 IoT.bzh Company
 *
 * SPDX-License-Identifier: Apache-2.0
 */

#include "zafb-helpers.h"
#include <stdio.h>
#include <zephyr/kernel.h>

#include <sys/rp-verbose.h>
#include <afb-v4.h>
#include <afb-apis.h>

/******************************************/
/* AFB ZEPHYR INTEGRATION SECTION - START */
/******************************************/
static struct afb_apiset *__zafb_all_apis__;

struct afb_apiset *zafb_apiset()
{
	if (__zafb_all_apis__ == NULL) {
		__zafb_all_apis__ = afb_apiset_create(NULL, 0);
	}
	return __zafb_all_apis__;
}	

static int __zafb_binding_add_preinit__(afb_api_t api, void *closure)
{
	int rc;
	const afb_binding_t *binding = closure;
	union afb_ctlarg ctlarg;

	/* record the description */
	afb_api_v4_set_userdata(api, binding->userdata);
	afb_api_v4_set_mainctl(api, binding->mainctl);
	afb_api_v4_set_verbs(api, binding->verbs);
	rc = 0;
	if (binding->provide_class)
		rc =  afb_api_v4_class_provide(api, binding->provide_class);
	if (!rc && binding->require_class)
		rc =  afb_api_v4_class_require(api, binding->require_class);
	if (!rc && binding->require_api)
		rc =  afb_api_v4_require_api(api, binding->require_api, 0);
	if (rc >= 0 && binding->mainctl) {
		/* call the pre init routine safely */
		memset(&ctlarg, 0, sizeof ctlarg);
		ctlarg.pre_init.path = NULL;
		ctlarg.pre_init.uid = binding->api;
		ctlarg.pre_init.config = NULL;
		rc = afb_api_v4_safe_ctlproc(api, binding->mainctl, afb_ctlid_Pre_Init, &ctlarg);
	}

	/* seal after init allows the pre init to add things */
	if (rc >= 0)
		afb_api_v4_seal(api);
	return rc;
}

int zafb_binding_add(afb_api_t *api, const afb_binding_t *binding)
{
	int rc = afb_api_v4_create(
		api,
		zafb_apiset(), zafb_apiset(),
		binding->api, Afb_String_Const,
		binding->info, Afb_String_Const,
		binding->noconcurrency,
		__zafb_binding_add_preinit__, (void*)binding,
		NULL, Afb_String_Const);
	return rc;
}

int zafb_start()
{
	return afb_apiset_start_all_services(zafb_apiset());
}
```

## src/zafb-helpers.h
```c
/*
 * Copyright (c) 2015-2025 IoT.bzh Company
 *
 * SPDX-License-Identifier: Apache-2.0
 */

#include <afb-v4.h>
#include <afb-apis.h>

struct afb_apiset *zafb_apiset();

int zafb_binding_add(afb_api_t *api, const afb_binding_t *binding);

int zafb_start();
```
